## arch/arm/mach-virt/Kconfig
```kconfig
if ARCH_VIRT

config SYS_VENDOR
	default "virt"

choice
	prompt "ARM architecture"
	default TARGET_VIRT_ARM_64BIT

config TARGET_VIRT_ARM_64BIT
	bool "ARMv8, 64bit"
	select ARM64
	select BOARD_LATE_INIT
	imply SYS_ARCH_TIMER_VIRTUAL

endchoice

config SYS_BOARD
	default "arm"

config SYS_CONFIG_NAME
	default "virt-arm"

endif
```

## board/virt/arm/Kconfig
```kconfig
if TARGET_VIRT_ARM_32BIT || TARGET_VIRT_ARM_64BIT

config TEXT_BASE
	default 0

config BOARD_SPECIFIC_OPTIONS # dummy
	def_bool y
	select QFW if ACPI
	select QFW_MMIO if CMD_QFW
	imply SYS_EARLY_PCI_INIT
	imply VIRTIO_MMIO
	imply VIRTIO_PCI
	imply VIRTIO_NET
	imply VIRTIO_BLK

endif
```

## configs/virt-arm_defconfig
```kconfig
CONFIG_ARM=y
CONFIG_KVM_VIRT_INS=y
CONFIG_ARCH_VIRT=y
CONFIG_TEXT_BASE=0x0
CONFIG_SYS_MALLOC_LEN=0x1000000
CONFIG_ENV_SIZE=0x40000
CONFIG_DM_GPIO=y
CONFIG_DEFAULT_DEVICE_TREE="virt-arm64"
CONFIG_SYS_LOAD_ADDR=0x0
CONFIG_PCI=y
CONFIG_SYS_MONITOR_BASE=0x00000000
CONFIG_FIT=y
CONFIG_FIT_SIGNATURE=y
CONFIG_FIT_VERBOSE=y
CONFIG_FIT_BEST_MATCH=y
CONFIG_BOOTSTD_FULL=y
CONFIG_LEGACY_IMAGE_FORMAT=y
CONFIG_USE_PREBOOT=y
# CONFIG_CONSOLE_RECORD is not set
# CONFIG_PRE_CONSOLE_BUFFER is not set
# CONFIG_DISPLAY_CPUINFO is not set
# CONFIG_DISPLAY_BOARDINFO is not set
# CONFIG_BOARD_INIT is not set
CONFIG_PCI_INIT_R=y
CONFIG_BLOBLIST=y
# CONFIG_HUSH_OLD_PARSER is not set
CONFIG_HUSH_MODERN_PARSER=y
CONFIG_CMDLINE_PS_SUPPORT=y
CONFIG_CMD_BDINFO_EXTRA=y
CONFIG_CMD_CONFIG=y
CONFIG_CMD_UFETCH=y
CONFIG_CMD_HISTORY=y
CONFIG_CMD_LICENSE=y
CONFIG_CMD_SM3SUM=y
CONFIG_SM3SUM_VERIFY=y
CONFIG_CMD_BOOTZ=y
CONFIG_BOOTM_OPENRTOS=y
CONFIG_CMD_BOOTMENU=y
CONFIG_CMD_ADTIMG=y
CONFIG_CMD_ELF_FDT_SETUP=y
CONFIG_CMD_ASKENV=y
CONFIG_CMD_GREPENV=y
CONFIG_CMD_ERASEENV=y
CONFIG_CMD_ENV_FLAGS=y
CONFIG_CMD_BINOP=y
CONFIG_CRC32_VERIFY=y
CONFIG_LOOPW=y
CONFIG_CMD_MD5SUM=y
CONFIG_MD5SUM_VERIFY=y
CONFIG_CMD_MEMINFO=y
CONFIG_CMD_MEMINFO_MAP=y
CONFIG_CMD_MEM_SEARCH=y
CONFIG_CMD_MX_CYCLIC=y
CONFIG_CMD_MEMTEST=y
CONFIG_SYS_ALT_MEMTEST=y
CONFIG_CMD_SHA1SUM=y
CONFIG_SHA1SUM_VERIFY=y
CONFIG_CMD_STRINGS=y
# CONFIG_CMD_UNZIP is not set
CONFIG_CMD_ZIP=y
CONFIG_CMD_BCB=y
CONFIG_CMD_BIND=y
# CONFIG_CMD_FLASH is not set
CONFIG_CMD_GPT=y
CONFIG_CMD_GPT_RENAME=y
CONFIG_CMD_LOADM=y
CONFIG_LOADS_ECHO=y
CONFIG_CMD_SAVES=y
CONFIG_SYS_LOADS_BAUD_CHANGE=y
CONFIG_CMD_LSBLK=y
CONFIG_CMD_MBR=y
CONFIG_CMD_CLONE=y
CONFIG_CMD_PCI=y
CONFIG_CMD_PCI_MPS=y
CONFIG_CMD_POWEROFF=y
CONFIG_CMD_READ=y
CONFIG_CMD_SDRAM=y
CONFIG_CMD_WRITE=y
CONFIG_CMD_CAT=y
CONFIG_CMD_SETEXPR_FMT=y
CONFIG_CMD_XXD=y
CONFIG_CMD_DNS=y
CONFIG_CMD_NFS=y
CONFIG_CMD_SNTP=y
CONFIG_CMD_WGET=y
CONFIG_WGET_HTTPS=y
CONFIG_CMD_2048=y
CONFIG_CMD_BMP=y
CONFIG_CMD_BSP=y
CONFIG_CMD_CACHE=y
CONFIG_CMD_CONITRACE=y
CONFIG_CMD_EXCEPTION=y
CONFIG_CMD_INI=y
CONFIG_CMD_RTC=y
CONFIG_CMD_TIME=y
CONFIG_CMD_GETTIME=y
CONFIG_CMD_PAUSE=y
CONFIG_CMD_RNG=y
CONFIG_CMD_KASLRSEED=y
CONFIG_CMD_TIMER=y
CONFIG_CMD_SYSBOOT=y
CONFIG_CMD_QFW=y
CONFIG_CMD_PSTORE=y
CONFIG_CMD_PSTORE_MEM_ADDR=0x0
CONFIG_CMD_TERMINAL=y
CONFIG_CMD_UUID=y
CONFIG_CMD_AES=y
CONFIG_CMD_HASH=y
CONFIG_HASH_VERIFY=y
CONFIG_CMD_TPM=y
CONFIG_CMD_MTDPARTS=y
CONFIG_CMD_DIAG=y
CONFIG_CMD_EVENT=y
CONFIG_CMD_LOG=y
CONFIG_CMD_UBI=y
CONFIG_CMD_UBI_RENAME=y
CONFIG_CMD_SPAWN=y
CONFIG_PARTITION_TYPE_GUID=y
CONFIG_OF_BOARD=y
CONFIG_OF_OMIT_DTB=y
CONFIG_ENV_IS_IN_EXT4=y
CONFIG_ENV_IS_IN_UBI=y
CONFIG_ENV_EXT4_INTERFACE="virtio"
CONFIG_ENV_EXT4_DEVICE_AND_PART="0"
CONFIG_ENV_EXT4_FILE="/boot/uboot.env"
CONFIG_ENV_UBI_PART="y"
CONFIG_NET_LWIP=y
CONFIG_LWIP_TCP_WND=32768
CONFIG_DM_DMA=y
CONFIG_SYSCON=y
CONFIG_SCSI_AHCI=y
CONFIG_AHCI_PCI=y
CONFIG_BLKMAP=y
# CONFIG_I2C is not set
CONFIG_INTERCONNECT=y
# CONFIG_MMC is not set
CONFIG_MTD=y
CONFIG_DM_MTD=y
CONFIG_MTD_NOR_FLASH=y
CONFIG_FLASH_SHOW_PROGRESS=0
CONFIG_CFI_FLASH=y
CONFIG_CFI_FLASH_USE_WEAK_ACCESSORS=y
CONFIG_SYS_FLASH_USE_BUFFER_WRITE=y
CONFIG_FLASH_CFI_MTD=y
CONFIG_SYS_FLASH_CFI=y
CONFIG_SYS_MAX_FLASH_SECT=256
CONFIG_SYS_MAX_FLASH_BANKS=2
CONFIG_SYS_MAX_FLASH_BANKS_DETECT=y
# CONFIG_UBI_SILENCE_MSG is not set
CONFIG_E1000=y
CONFIG_NVME_PCI=y
CONFIG_PCIE_ECAM_GENERIC=y
CONFIG_RTC_EMULATION=y
CONFIG_SCSI=y
CONFIG_SPECIFY_CONSOLE_INDEX=y
CONFIG_SYSINFO=y
CONFIG_SYSINFO_SMBIOS=y
CONFIG_SYSRESET=y
CONFIG_SYSRESET_CMD_POWEROFF=y
CONFIG_TPM2_MMIO=y
CONFIG_USB_EHCI_HCD=y
CONFIG_USB_EHCI_PCI=y
CONFIG_VIDEO_BMP_GZIP=y
# CONFIG_UBIFS_SILENCE_MSG is not set
# CONFIG_RANDOM_UUID is not set
CONFIG_SEMIHOSTING=y
CONFIG_MBEDTLS_LIB=y
CONFIG_CRYPT_PW=y
CONFIG_CRYPT_PW_SHA256=y
CONFIG_CRYPT_PW_SHA512=y
CONFIG_TPM=y
CONFIG_UTHREAD=y
CONFIG_UNIT_TEST=y
```
